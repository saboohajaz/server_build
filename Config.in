## Config.in
```kconfig
source "$BR2_EXTERNAL_PORTAL_PATH/package/loragateway/Config.in"
source "$BR2_EXTERNAL_PORTAL_PATH/package/packet_forwarder/Config.in"
source "$BR2_EXTERNAL_PORTAL_PATH/package/lora_server_brocaar/Config.in"
```

## configs/raspberrypi3_defconfig
```kconfig
BR2_arm=y
BR2_cortex_a53=y
BR2_ARM_FPU_NEON_VFPV4=y

BR2_TOOLCHAIN_BUILDROOT_GLIBC=y
BR2_TOOLCHAIN_BUILDROOT_CXX=y
BR2_TOOLCHAIN_BUILDROOT_WCHAR=y

BR2_SYSTEM_DHCP=""

BR2_LINUX_KERNEL=y
BR2_LINUX_KERNEL_CUSTOM_GIT=y
BR2_LINUX_KERNEL_CUSTOM_REPO_URL="https://github.com/raspberrypi/linux.git"
BR2_LINUX_KERNEL_CUSTOM_REPO_VERSION="33ee56d5927ceff630fbc87e3f5caa409b6ae114"
BR2_LINUX_KERNEL_DEFCONFIG="bcm2709"
BR2_LINUX_KERNEL_CONFIG_FRAGMENT_FILES="${BR2_EXTERNAL_PORTAL_PATH}/board/raspberrypi3/linux.config"
# Build the DTB from the kernel sources
BR2_LINUX_KERNEL_DTS_SUPPORT=y
BR2_LINUX_KERNEL_INTREE_DTS_NAME="bcm2710-rpi-3-b bcm2710-rpi-cm3"

BR2_TARGET_GENERIC_ISSUE="Portal provided by Fleet Technologies"
BR2_TARGET_GENERIC_HOSTNAME="FleetPortal"
BR2_TARGET_GENERIC_ROOT_PASSWD="Fleet123"

# Filesystem / image
BR2_TARGET_ROOTFS_EXT2=y
BR2_TARGET_ROOTFS_EXT2_4=y
BR2_TARGET_ROOTFS_EXT2_BLOCKS=3600000
BR2_TARGET_ROOTFS_EXT2_LABEL="rootfs"

BR2_TARGET_TZ_INFO=y
BR2_TARGET_TZ_ZONELIST="default"
BR2_TARGET_LOCALTIME="Australia/Adelaide"

# BR2_TARGET_ROOTFS_TAR is not set
BR2_ROOTFS_POST_BUILD_SCRIPT="board/raspberrypi3/post-build.sh"
BR2_ROOTFS_POST_IMAGE_SCRIPT="${BR2_EXTERNAL_PORTAL_PATH}/board/raspberrypi3/post-image.sh"
BR2_ROOTFS_POST_SCRIPT_ARGS="--add-pi3-miniuart-bt-overlay --add-spi=on-param"
BR2_ROOTFS_USERS_TABLES="${BR2_EXTERNAL_PORTAL_PATH}/common/users.txt"
BR2_ROOTFS_OVERLAY="$(BR2_EXTERNAL)/common/overlay"

CONFIG_I2C_MUX_GPIO=y
CONFIG_CMD_GPIO=y

BR2_PACKAGE_RPI_FIRMWARE=y
BR2_PACKAGE_SPI_TOOLS=y
# Required tools to create the SD image
BR2_PACKAGE_HOST_DOSFSTOOLS=y
BR2_PACKAGE_HOST_GENIMAGE=y
BR2_PACKAGE_HOST_MTOOLS=y
# Linux headers same as kernel, a 4.9 series
BR2_PACKAGE_HOST_LINUX_HEADERS_CUSTOM_4_9=y

BR2_PACKAGE_ZLIB=y
BR2_PACKAGE_OPENSSL=y
BR2_PACKAGE_OPENSSL_BIN=y
BR2_PACKAGE_OPENSSL_ENGINES=y
BR2_PACKAGE_OPENSSH=y
BR2_PACKAGE_SUDO=y
BR2_PACKAGE_NANO=y
BR2_PACKAGE_NANO_TINY=y
BR2_PACKAGE_RPI_WIFI_FIRMWARE=y 
BR2_PACKAGE_WPA_SUPPLICANT=y 
BR2_PACKAGE_WPA_SUPPLICANT_NL80211=y 
BR2_PACKAGE_WPA_SUPPLICANT_AP_SUPPORT=y 
BR2_PACKAGE_WPA_SUPPLICANT_EAP=y 
BR2_PACKAGE_WPA_SUPPLICANT_WPS=y 
BR2_PACKAGE_WPA_SUPPLICANT_CLI=y 
BR2_PACKAGE_WPA_SUPPLICANT_PASSPHRASE=y
BR2_PACKAGE_BUSYBOX_SHOW_OTHERS=y
BR2_PACKAGE_START_STOP_DAEMON=y
BR2_PACKAGE_IW=y
BR2_PACKAGE_HOSTAPD=y
BR2_PACKAGE_DNSMASQ=y
BR2_PACKAGE_PPPD=y
BR2_PACKAGE_RP_PPPOE=y
BR2_PACKAGE_LIBWEBSOCKETS=y
BR2_PACKAGE_LIGHTTPD=y
BR2_PACKAGE_LIGHTTPD_PCRE=y
BR2_PACKAGE_PCRE=y

# Portal Packages
BR2_PACKAGE_LORAGATEWAY=y
BR2_PACKAGE_PACKET_FORWARDER=y
BR2_PACKAGE_PACKET_FORWARDER_PIN_NUMBER=17
BR2_PACKAGE_LORA_SERVER_BROCAAR=y
BR2_PACKAGE_LORA_SERVER_BROCAAR_INIT_LVL=71
BR2_PACKAGE_INMARSAT_BGAN=y
```

## package/Inmarsat_BGAN/Config.in
```kconfig
menuconfig BR2_PACKAGE_INMARSAT_BGAN
	bool "Inmarsat BGAN"
	default y
	select BR2_PACKAGE_RP_PPPOE
	select BR2_PACKAGE_PPPD
	help
		Driver for Inmarsat BGAN
```

## package/lora_server_brocaar/Config.in
```kconfig
menuconfig BR2_PACKAGE_LORA_SERVER_BROCAAR
	bool "Lora Server Brocaar"
	default y
	select BR2_PACKAGE_MOSQUITTO
	select BR2_PACKAGE_REDIS
	select BR2_PACKAGE_POSTGRESQL
	select BR2_PACKAGE_NODEJS
	select BR2_PACKAGE_HOST_GO_FLEET_ARCH_SUPPORTS
	select BR2_PACKAGE_HOST_GO_CGO_LINKING_SUPPORTS
	select BR2_PACKAGE_PROTOBUF
	select BR2_PACKAGE_PACKET_FORWARDER
	help
		Lora Server Brocaar

if BR2_PACKAGE_LORA_SERVER_BROCAAR
	config BR2_PACKAGE_LORA_SERVER_BROCAAR_INIT_LVL
		int "Start script Run Level for Setup & Daemons creation"
		default 71
		range 10 99
		depends on BR2_PACKAGE_LORA_SERVER_BROCAAR
		help
			The initialization priority level of LoRa Server daemons
endif
```

## package/loragateway/Config.in
```kconfig
menuconfig BR2_PACKAGE_LORAGATEWAY
	bool "Lora Gateway"
	default y
	help
		General Hardware Abstraction Layer for chip and SPI features
```

## package/packet_forwarder/Config.in
```kconfig
menuconfig BR2_PACKAGE_PACKET_FORWARDER
	bool "Packet Forwarder"
	default y
	select BR2_PACKAGE_LORAGATEWAY
	help
		Packet Forwarder

if BR2_PACKAGE_PACKET_FORWARDER
	config BR2_PACKAGE_PACKET_FORWARDER_PIN_NUMBER
		int "Hardware Pin Number for LoRa Packets"
		default 7
		range 1 99
		depends on BR2_PACKAGE_LORAGATEWAY
		help
			7 (Rising HF), 17 (RAK systems), 25 (IMST)

	choice
		prompt "Target Region"
		default BR2_PACKAGE_PACKET_FORWARDER_AUS
		help
		  Select the target region build for.

	config BR2_PACKAGE_PACKET_FORWARDER_AUS
		bool "Australia Region"
		help
		  Australian frequencies and power setup.

	config BR2_PACKAGE_PACKET_FORWARDER_EU
		bool "European Region"
		help
		  European frequencies and power setup.

	config BR2_PACKAGE_PACKET_FORWARDER_US
		bool "US Region"
		help
		  US frequencies and power setup.

	endchoice

endif
```

## package/portal_engine/Config.in
```kconfig
menuconfig BR2_PACKAGE_PORTAL_ENGINE
	bool "Portal Engine"
	default y
	select BR2_PACKAGE_HOST_GO_FLEET_ARCH_SUPPORTS
	select BR2_PACKAGE_HOST_GO_CGO_LINKING_SUPPORTS
	select BR2_PACKAGE_LORA_SERVER_BROCAAR
	help
		Portal Engine
```
